## boards/arm/em5340_v1/Kconfig.board
```kconfig
# Copyright (c) 2022 Nordic Semiconductor ASA
# SPDX-License-Identifier: Apache-2.0

config BOARD_EM5340_V1
	bool "EM5340_V1"
	depends on SOC_NRF5340_CPUAPP_QKAA
```

## boards/arm/em5340_v1/Kconfig.defconfig
```kconfig
# Copyright (c) 2022 Nordic Semiconductor ASA
# SPDX-License-Identifier: Apache-2.0

if BOARD_EM5340_V1

config BOARD
	default "em5340_v1"


endif
```

## boards/arm/em5340_v1/em5340_v1_defconfig
```kconfig
# Copyright (c) 2022 Nordic Semiconductor ASA
# SPDX-License-Identifier: Apache-2.0

CONFIG_SOC_SERIES_NRF53X=y
CONFIG_SOC_NRF5340_CPUAPP_QKAA=y
CONFIG_BOARD_EM5340_V1=y

# Enable MPU
CONFIG_ARM_MPU=y

# Enable hardware stack protection
CONFIG_HW_STACK_PROTECTION=y

# Enable TrustZone-M
CONFIG_ARM_TRUSTZONE_M=y

CONFIG_CLOCK_CONTROL_NRF_K32SRC_RC=y
CONFIG_SOC_ENABLE_LFXO=n

# enable GPIO
CONFIG_GPIO=y

# Enable uart driver
CONFIG_SERIAL=y

# enable console
CONFIG_CONSOLE=y
CONFIG_UART_CONSOLE=y

CONFIG_PINCTRL=y
```

## hello_world/build/Kconfig/Kconfig.shield
```kconfig
osource "e:/temp/EM5340_test/boards/shields/*/Kconfig.shield"
osource "C:/ncs/v2.1.0/nrf/boards/shields/*/Kconfig.shield"
```

## hello_world/build/Kconfig/Kconfig.shield.defconfig
```kconfig
osource "e:/temp/EM5340_test/boards/shields/*/Kconfig.defconfig"
osource "C:/ncs/v2.1.0/nrf/boards/shields/*/Kconfig.defconfig"
```
